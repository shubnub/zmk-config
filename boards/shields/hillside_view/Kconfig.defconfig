## boards/shields/hillside_view/Kconfig.defconfig
```kconfig
if SHIELD_HILLSIDE_VIEW_LEFT

# Name must be less than 16 characters long!
config ZMK_KEYBOARD_NAME
    default "HillSide View"

config ZMK_SPLIT_ROLE_CENTRAL
    default y

config ZMK_USB
  default y

endif

if SHIELD_HILLSIDE_VIEW_LEFT || SHIELD_HILLSIDE_VIEW_RIGHT

config ZMK_SPLIT
    default y

config ZMK_DISPLAY
    select LV_FONT_UNSCII_16

config I2C
  default y

if ZMK_DISPLAY

config ZMK_DISPLAY_BLANK_ON_IDLE
  default n

config SPI
    default y

config LS0XX
    default y

config LV_Z_BITS_PER_PIXEL
    default 1

choice LV_COLOR_DEPTH
    default LV_COLOR_DEPTH_1
endchoice

endif # ZMK_DISPLAY

if LVGL

config LV_Z_VDB_SIZE
    default 64

config LV_DPI_DEF
    default 148

config LV_Z_BITS_PER_PIXEL
    default 1

choice LV_COLOR_DEPTH
    default LV_COLOR_DEPTH_1

endchoice

endif # LVGL

endif # SHIELD_HSV_LEFT || SHIELD_HSV_RIGHT
```

## config/west.yml
```yaml
manifest:
  defaults:
    revision: v0.3
  remotes:
    - name: zmkfirmware
      url-base: https://github.com/zmkfirmware
    # - name: shubnub
    #   url-base: https://github.com/shubnub
    - name: m165437
      url-base: https://github.com/M165437
  projects:
    - name: zmk
      remote: zmkfirmware
      import: app/west.yml
    # - name: zmk-hsv-module
    #   remote: shubnub
    #   # path: modules/zmk-hsv-module
    - name: nice-view-gem
      remote: m165437
      revision: v0.3.0
      # path: modules/nice-view-gem
  self:
    path: config
```
